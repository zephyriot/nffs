## Kconfig.module
```kconfig
config FILE_SYSTEM_NFFS
	bool "NFFS file system support"
	select FLASH_PAGE_LAYOUT
	help
	  Enables NFFS file system support.
	  Note: NFFS requires 1-byte unaligned access to flash thus it
	  will not work on devices that support only aligned flash access.

menu "NFFS Settings"
	visible if FILE_SYSTEM_NFFS

config FS_NFFS_FLASH_DEV_NAME
	string
	prompt "Flash device name to be used"

config FS_NFFS_NUM_INODES
	int "Maximum number of inodes"
	range 1 32768
	default 100

config FS_NFFS_NUM_BLOCKS
	int "Maximum number of blocks"
	range 1 32768
	default 100

config FS_NFFS_NUM_FILES
	int "Maximum number of opened files"
	range 1 256
	default 4

config FS_NFFS_NUM_DIRS
	int "Maximum number of opened directories"
	range 1 256
	default 4

config FS_NFFS_NUM_CACHE_INODES
	int "Number of cached files' inodes"
	range 1 512
	default 4

config FS_NFFS_NUM_CACHE_BLOCKS
	int "Number of cached blocks"
	range 1 512
	default 64

config NFFS_FILESYSTEM_MAX_AREAS
	int "Maximum number of areas"
	depends on FILE_SYSTEM_NFFS
	range 2 64
	default 8
	help
	  This defines maximum number of areas located on flash. Each area can
	  be erased without affecting other areas thus the size of area can
	  affect performance of GC where single area has to be rewritten.
	  At least one scratch and one non-scratch area is required.

config NFFS_FILESYSTEM_MAX_BLOCK_SIZE
	int "Maximum block size"
	depends on FILE_SYSTEM_NFFS
	range 16 2048
	default 2048
	help
	  This determines the maximum size of data block written to flash.
	  Writes larger than this size are split into multiple write operations.

endmenu
```
